/*
  24LC32A EEPROM programmer for Arduino UNO (I2C)
  - Writes the contents of rom.hex (embedded below) to EEPROM addresses 0x0000..0x0FFF
  - Verifies every byte after writing

  Notes:
  - 24LC32A page size is 32 bytes, but Arduino Wire TX buffer is 32 bytes total.
    So we write in 16-byte chunks (never crosses a 32-byte page boundary).
*/

#include <Wire.h>
#include <avr/pgmspace.h>

static const uint8_t EEPROM_ADDR = 0x50;   // A2=A1=A0 = GND
static const uint16_t EEPROM_SIZE = 4096;  // 24LC32A = 4KB
static const uint8_t CHUNK = 16;           // fits Wire buffer and aligns with 32-byte pages

// ===== Embedded image from rom.hex (4096 bytes) =====
const uint8_t ROM_IMAGE[EEPROM_SIZE] PROGMEM = {
  0x00, 0x00, 0x02, 0x05, 0x02, 0x66, 0x01, 0x8D, 0x00, 0x10, 0x04, 0x85, 0x00, 0x00, 0x04, 0x86,
  0x00, 0x00, 0x02, 0x05, 0x04, 0xCC, 0x03, 0x2D, 0x00, 0x10, 0x04, 0xA5, 0x00, 0x00, 0x04, 0xA6,
  0x40, 0x00, 0x02, 0xA4, 0x00, 0x00, 0x02, 0xAA, 0x00, 0xA3, 0x05, 0x45, 0x40, 0x00, 0x05, 0x46,
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  0x00, 0x00, 0x00, 0x11, 0x00, 0x00, 0x00, 0x11, 0x00, 0x00, 0x00, 0x11, 0x00, 0x00, 0x00, 0x11
  
};

static void ackPoll() {
  while (true) {
    Wire.beginTransmission(EEPROM_ADDR);
    uint8_t err = Wire.endTransmission();
    if (err == 0) return;
    delay(1);
  }
}

static bool eepromWriteChunk(uint16_t addr, const uint8_t *data, uint8_t len) {
  Wire.beginTransmission(EEPROM_ADDR);
  Wire.write((uint8_t)(addr >> 8));
  Wire.write((uint8_t)(addr & 0xFF));
  for (uint8_t i = 0; i < len; i++) Wire.write(data[i]);
  uint8_t err = Wire.endTransmission();
  if (err != 0) return false;
  ackPoll();
  return true;
}

static bool eepromReadChunk(uint16_t addr, uint8_t *out, uint8_t len) {
  Wire.beginTransmission(EEPROM_ADDR);
  Wire.write((uint8_t)(addr >> 8));
  Wire.write((uint8_t)(addr & 0xFF));
  uint8_t err = Wire.endTransmission(false);
  if (err != 0) return false;

  uint8_t got = Wire.requestFrom((int)EEPROM_ADDR, (int)len);
  if (got != len) return false;

  for (uint8_t i = 0; i < len; i++) out[i] = (uint8_t)Wire.read();
  return true;
}

static void printHex2(uint8_t v) {
  const char hex[] = "0123456789ABCDEF";
  Serial.print(hex[(v >> 4) & 0x0F]);
  Serial.print(hex[v & 0x0F]);
}

void setup() {
  Serial.begin(115200);
  while (!Serial) {}

  Serial.println(F("I2C EEPROM programmer (24LC32A) starting..."));
  Wire.begin();
  Wire.setClock(100000);

  uint8_t tmp;
  if (!eepromReadChunk(0x0000, &tmp, 1)) {
    Serial.println(F("ERROR: EEPROM not responding."));
    while (true) delay(1000);
  }
  Serial.print(F("EEPROM detected. Byte[0x0000]=0x"));
  printHex2(tmp);
  Serial.println();

  Serial.println(F("Writing 4096 bytes..."));

  uint8_t buf[CHUNK];
  uint8_t rb[CHUNK];

  for (uint16_t addr = 0; addr < EEPROM_SIZE; addr += CHUNK) {
    for (uint8_t i = 0; i < CHUNK; i++) {
      buf[i] = pgm_read_byte_near(ROM_IMAGE + addr + i);
    }

    if (!eepromWriteChunk(addr, buf, CHUNK)) {
      Serial.print(F("WRITE ERROR at 0x"));
      Serial.println(addr, HEX);
      while (true) delay(1000);
    }

    if (!eepromReadChunk(addr, rb, CHUNK)) {
      Serial.print(F("READ ERROR at 0x"));
      Serial.println(addr, HEX);
      while (true) delay(1000);
    }

    for (uint8_t i = 0; i < CHUNK; i++) {
      if (rb[i] != buf[i]) {
        uint16_t bad = addr + i;
        Serial.print(F("FAIL at 0x"));
        Serial.print(bad, HEX);
        Serial.print(F(" expected 0x"));
        printHex2(buf[i]);
        Serial.print(F(" got 0x"));
        printHex2(rb[i]);
        Serial.println();
        while (true) delay(1000);
      }
    }

    if ((addr % 256) == 0) {
      Serial.print(F("...OK up to 0x"));
      Serial.println(addr, HEX);
    }
  }

  Serial.println(F("SUCCESS: EEPROM programmed and verified (0x0000..0x0FFF)."));
}

void loop() {}